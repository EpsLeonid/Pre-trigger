-- WARNING: Do NOT edit the input and output ports in this file in a text
-- editor if you plan to continue editing the block that represents it in
-- the Block Editor! File corruption is VERY likely to occur.

-- Copyright (C) 1991-2009 Altera Corporation
-- Your use of Altera Corporation's design tools, logic functions 
-- and other software and tools, and its AMPP partner logic 
-- functions, and any output files from any of the foregoing 
-- (including device programming or simulation files), and any 
-- associated documentation or information are expressly subject 
-- to the terms and conditions of the Altera Program License 
-- Subscription Agreement, Altera MegaCore Function License 
-- Agreement, or other applicable license agreement, including, 
-- without limitation, that your use is for the sole purpose of 
-- programming logic devices manufactured by Altera and sold by 
-- Altera or its authorized distributors.  Please refer to the 
-- applicable agreement for further details.


-- Generated by Quartus II 64-Bit Version 9.1 (Build Build 222 10/21/2009)
-- Created on Thu Feb 07 17:19:03 2013

FUNCTION VMEbus (clock, Confirm, WRITE, DS0, DS1, LWORD, AS, AccessGranted, DataBusStrobe, AM[5..0], IACK, IACKIN, AddressBus[23..0], DataBusIn[15..0], BaseAddr[11..0], Busy_on_Copy, DeadTime)
	WITH (RefClock)
	RETURNS (VME_Active, Start, Reset, ERROR, AccessRequest, DTACK, IACKOUT, IRQ[7..1], AddrBusOut[15..0], DataBusOut[15..0], VMEMessage, test[4..0]);
